## boards/shields/prototype_kb/Kconfig.defconfig
```kconfig
# Copyright (c) 2022 The ZMK Contributors
# SPDX-License-Identifier: MIT

if SHIELD_PROTOTYPE_KB

config ZMK_KEYBOARD_NAME
    default "Prototype kb"

endif
```

## boards/shields/prototype_kb/Kconfig.shield
```kconfig
# Copyright (c) 2022 The ZMK Contributors
# SPDX-License-Identifier: MIT

config SHIELD_PROTOTYPE_KB
    def_bool $(shields_list_contains,prototype_kb)
```
