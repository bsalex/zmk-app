/*
 * Copyright (c) 2022 The ZMK Contributors
 *
 * SPDX-License-Identifier: MIT
 */

/ {
    chosen {
        zmk,kscan = &kscan0;
    };

    kscan0: kscan {
        compatible = "zmk,kscan-gpio-direct";
        wakeup-source;

        input-gpios
            = <&pro_micro 6 (GPIO_ACTIVE_LOW | GPIO_PULL_UP)>
            , <&pro_micro 7 (GPIO_ACTIVE_LOW | GPIO_PULL_UP)>
            , <&pro_micro 8 (GPIO_ACTIVE_LOW | GPIO_PULL_UP)>
            ;

    };

    /* assign feedback device from actual DRV2605 i2c device */
    lra0: output_haptic_fb_0 {
        compatible = "zmk,output-haptic-feedback";
        #binding-cells = <0>;
        /* only one driver type is supported now */
        driver = "drv2605";
        /* labled i2c device with [zmk-drv2605-driver] */
        device = <&drv2605_0>;
    };
};